## conf/layer.conf
```bitbake
# We have a conf and classes directory, add to BBPATH
BBPATH .= ":${LAYERDIR}"

# We have recipes-* directories, add to BBFILES
BBFILES += "${LAYERDIR}/recipes-*/*/*.bb \
            ${LAYERDIR}/recipes-*/*/*.bbappend"

BBFILE_COLLECTIONS += "meta-audiopi"
BBFILE_PATTERN_meta-audiopi = "^${LAYERDIR}/"
BBFILE_PRIORITY_meta-audiopi = "6"

LAYERDEPENDS_meta-audiopi = "core"
LAYERSERIES_COMPAT_meta-audiopi = "dunfell"
```
